/*
 * Copyright (c) 2024 Nordic Semiconductor ASA
 *
 * SPDX-License-Identifier: LicenseRef-Nordic-5-Clause
 */

/* Application does not use cpuflpr core. Assign whole RRAM to cpuapp. */
&cpuapp_rram {
	reg = < 0x0 DT_SIZE_K(1524) >;
};

/ {
	cs_antenna_switch: cs-antenna-config {
		status = "okay";
		compatible = "nordic,bt-cs-antenna-switch";
		ant-gpios = <&gpio1 11 (GPIO_ACTIVE_HIGH)>,
			    <&gpio1 12 (GPIO_ACTIVE_HIGH)>,
			    <&gpio1 13 (GPIO_ACTIVE_HIGH)>,
			    <&gpio1 14 (GPIO_ACTIVE_HIGH)>;
		multiplexing-mode = <0>;
	};
};
